## CMakeLists.txt
```
cmake_minimum_required(VERSION 3.13.1)

find_package(Zephyr)
project(gpio)

target_sources(app PRIVATE src/main.c src/controller.c ../../common/heartbeat.c)
```

## prj.conf
```kconfig
CONFIG_BOOT_BANNER=y
CONFIG_PRINTK=y
CONFIG_CONSOLE=y
CONFIG_UART_CONSOLE=y
CONFIG_LOG=y
```

## src/main.c
```c
/*
 * SPDX-License-Identifier: Apache-2.0
 */

#include <zephyr/kernel.h>
#include <zephyr/device.h>
#include <zephyr/drivers/gpio.h>
#include <zephyr/drivers/uart.h>
#include <zephyr/sys/printk.h>
#include <zephyr/sys/__assert.h>
#include <string.h>
#include "controller.h"
#include "threads.h"

#define RED		0x011E
#define GREEN		0x01E1
#define BLUE		0x0E11
#define WHITE		0x0FFF
#define BLACK		0x0000
#define GREY		0x0AAA

#define ROWS		100
#define COLUMNS		75

#define PIXEL(x, y)	(((x) + ROWS * (y)) & 0xFFFF)
#define GET_X(pixel)	((pixel) % ROWS)
#define GET_Y(pixel)	((pixel) / ROWS)

#include "background.h"

#define MOVE_RIGHT	0x1 <<  0
#define MOVE_UP		0x1 <<  1
#define MOVE_LEFT	0x1 <<  2
#define MOVE_DOWN	0x1 <<  3


extern struct k_fifo cursor_fifo;

void inline write_pixel(volatile unsigned int *framebuffer, int address, int pixel)
{
	*framebuffer = ((pixel & 0xFFFF) << 16) | (address & 0xFFFF);
}

struct snake_node {
	unsigned short pixel;
	unsigned short color;
};
struct snake_node snake_nodes[100];

unsigned int start = false;
unsigned int direction = MOVE_RIGHT;
unsigned int color;

void draw_cover(volatile unsigned int *framebuffer, int clear)
{
	int i;

	for (i = 0; i < RED_PIXELS; i++) {
		write_pixel(framebuffer, red_pixel[i], clear ? BLACK : RED);
	}
	for (i = 0; i < GREEN_PIXELS; i++) {
		write_pixel(framebuffer, green_pixel[i], clear ? BLACK : GREEN);
	}
	for (i = 0; i < BLUE_PIXELS; i++) {
		write_pixel(framebuffer, blue_pixel[i], clear ? BLACK : BLUE);
	}
	for (i = 0; i < GREY_PIXELS; i++) {
		write_pixel(framebuffer, grey_pixel[i], clear ? BLACK : GREY);
	}

}

void draw_frame(volatile unsigned int *framebuffer, unsigned short color)
{
	int i;

	for (i = 0; i < ROWS; i++) {
		write_pixel(framebuffer, PIXEL(i, 0), color);
		write_pixel(framebuffer, PIXEL(i, COLUMNS - 1), color);
	}

	for (i = 0; i < COLUMNS; i++) {
		write_pixel(framebuffer, PIXEL(0, i), color);
		write_pixel(framebuffer, PIXEL(ROWS - 1, i), color);
	}
}

int random_pixel()
{
	unsigned int i = k_cycle_get_32();
	unsigned int x = (i % (ROWS - 2)) + 1;
	unsigned int y = (i % (COLUMNS - 2)) + 1;

	printk("random loot on PIXEL(%i, %i)\n", x, y);
	return PIXEL(x, y);
}

int random_color()
{
	return (k_cycle_get_32() + 100) & 0xEEE;
}

void exit_game(volatile unsigned int *framebuffer)
{
	draw_frame(framebuffer, RED);
	while (1)
		k_sleep(K_SECONDS(1));
}

void framesync(void)
{
	int i;
	volatile unsigned int *framebuffer = (unsigned int *)0xF0050000;
	unsigned short loot;
	unsigned int snake_length = 7;
	unsigned int pixel;
	unsigned int snake_direction;

	for (i = 0; i < snake_length; i++) {
		snake_nodes[i].pixel = PIXEL(48 + 1, 10);
		snake_nodes[i].color = random_color();
	}

	loot = random_pixel();
	color = random_color();

	/* Draw game border */
	draw_frame(framebuffer, WHITE);

	/* Draw cover characters */
	draw_cover(framebuffer, false);

	/* Wait until to start the game */
	while(!start)
		k_sleep(K_MSEC(500));

	draw_cover(framebuffer, true);

	for (i = 0; i < snake_length; i++) {
		write_pixel(framebuffer, snake_nodes[i].pixel,
					 snake_nodes[i].color);
	}

	while (1) {
		snake_direction = direction;
		pixel = snake_nodes[snake_length - 1].pixel;
		switch (snake_direction) {
		case MOVE_UP:
			pixel = PIXEL(GET_X(pixel), GET_Y(pixel) - 1);
			break;
		case MOVE_RIGHT:
			pixel = PIXEL(GET_X(pixel) + 1, GET_Y(pixel));
			break;
		case MOVE_DOWN:
			pixel = PIXEL(GET_X(pixel), GET_Y(pixel) + 1);
			break;
		case MOVE_LEFT:
			pixel = PIXEL(GET_X(pixel) - 1, GET_Y(pixel));
			break;
		}
		if (pixel == loot) {
			snake_nodes[snake_length].pixel = pixel;
			snake_nodes[snake_length].color = color;
			snake_length++;
			loot = random_pixel();
			color = random_color();
		} else {
			write_pixel(framebuffer, snake_nodes[0].pixel, BLACK);
			for (i = 0; i < snake_length - 1; i++) {
				snake_nodes[i].pixel = snake_nodes[i + 1].pixel;
			}

			snake_nodes[snake_length - 1].pixel = pixel;
		}

		/* Draw loot */
		write_pixel(framebuffer, loot, color);

		/* Detect collisions */
		if (GET_X(pixel) == 0 || GET_X(pixel) == ROWS - 1 ||
		    GET_Y(pixel) == 0 || GET_Y(pixel) == COLUMNS - 1) {
			exit_game(framebuffer);
		}

		for (i = 0; i < snake_length - 2; i++) {
			if (snake_nodes[i].pixel == pixel) {
				exit_game(framebuffer);
			}
		}

		/* Draw snake */
		for (i = 0; i < snake_length; i++) {
			write_pixel(framebuffer, snake_nodes[i].pixel,
						 snake_nodes[i].color);
		}
		k_sleep(K_MSEC(150));
	}
}

void pixelmover(void)
{
	struct cursor_data *cursor;

	while (1) {
		cursor = k_fifo_get(&cursor_fifo, K_FOREVER);

		switch (cursor->command) {
		case PLYR1_ARROW_UP:
			if (direction != MOVE_DOWN)
				direction = cursor->command;
			break;
		case PLYR1_ARROW_RIGHT:
			if (direction != MOVE_LEFT)
				direction = cursor->command;
			break;
		case PLYR1_ARROW_DOWN:
			if (direction != MOVE_UP)
				direction = cursor->command;
			break;
		case PLYR1_ARROW_LEFT:
			if (direction != MOVE_RIGHT)
				direction = cursor->command;
			break;
		case PLYR1_SELECT:
			/* Wait for first button A input to start */
			if (!start) {
				start = true;
				break;
			}
			color = random_color();
			break;
		}
	}
}

K_THREAD_DEFINE(framesync_tid, FRAMESYNC_STACKSIZE, framesync, NULL, NULL, NULL,
		FRAMESYNC_PRIORITY, 0, 0);
K_THREAD_DEFINE(pixelmover_tid, PIXELMOVER_STACKSIZE, pixelmover, NULL, NULL, NULL,
		PIXELMOVER_PRIORITY, 0, 0);
```

## src/background.h
```c
#ifndef BACKGROUND_H
#define BACKGROUND_H

#define	RED_PIXELS	66

unsigned short red_pixel[RED_PIXELS] = {
	PIXEL(29, 17),
	PIXEL(29, 18),
	PIXEL(14, 19),
	PIXEL(15, 19),
	PIXEL(16, 19),
	PIXEL(17, 19),
	PIXEL(29, 19),
	PIXEL(13, 20),
	PIXEL(18, 20),
	PIXEL(29, 20),
	PIXEL(12, 21),
	PIXEL(29, 21),
	PIXEL(58, 21),
	PIXEL(60, 21),
	PIXEL(61, 21),
	PIXEL(62, 21),
	PIXEL(67, 21),
	PIXEL(68, 21),
	PIXEL(69, 21),
	PIXEL(70, 21),
	PIXEL(12, 22),
	PIXEL(29, 22),
	PIXEL(58, 22),
	PIXEL(59, 22),
	PIXEL(63, 22),
	PIXEL(66, 22),
	PIXEL(71, 22),
	PIXEL(12, 23),
	PIXEL(29, 23),
	PIXEL(58, 23),
	PIXEL(63, 23),
	PIXEL(71, 23),
	PIXEL(12, 24),
	PIXEL(29, 24),
	PIXEL(58, 24),
	PIXEL(63, 24),
	PIXEL(67, 24),
	PIXEL(68, 24),
	PIXEL(69, 24),
	PIXEL(70, 24),
	PIXEL(71, 24),
	PIXEL(12, 25),
	PIXEL(29, 25),
	PIXEL(58, 25),
	PIXEL(63, 25),
	PIXEL(66, 25),
	PIXEL(71, 25),
	PIXEL(13, 26),
	PIXEL(18, 26),
	PIXEL(29, 26),
	PIXEL(58, 26),
	PIXEL(63, 26),
	PIXEL(66, 26),
	PIXEL(70, 26),
	PIXEL(71, 26),
	PIXEL(14, 27),
	PIXEL(15, 27),
	PIXEL(16, 27),
	PIXEL(17, 27),
	PIXEL(29, 27),
	PIXEL(58, 27),
	PIXEL(63, 27),
	PIXEL(67, 27),
	PIXEL(68, 27),
	PIXEL(69, 27),
	PIXEL(71, 27)
};


#define	GREEN_PIXELS	50

unsigned short green_pixel[GREEN_PIXELS] = {
	PIXEL(74, 17),
	PIXEL(74, 18),
	PIXEL(74, 19),
	PIXEL(74, 20),
	PIXEL(22, 21),
	PIXEL(23, 21),
	PIXEL(24, 21),
	PIXEL(25, 21),
	PIXEL(41, 21),
	PIXEL(43, 21),
	PIXEL(44, 21),
	PIXEL(74, 21),
	PIXEL(78, 21),
	PIXEL(21, 22),
	PIXEL(22, 22),
	PIXEL(25, 22),
	PIXEL(26, 22),
	PIXEL(41, 22),
	PIXEL(42, 22),
	PIXEL(74, 22),
	PIXEL(77, 22),
	PIXEL(21, 23),
	PIXEL(26, 23),
	PIXEL(41, 23),
	PIXEL(74, 23),
	PIXEL(76, 23),
	PIXEL(21, 24),
	PIXEL(26, 24),
	PIXEL(41, 24),
	PIXEL(74, 24),
	PIXEL(75, 24),
	PIXEL(21, 25),
	PIXEL(26, 25),
	PIXEL(41, 25),
	PIXEL(74, 25),
	PIXEL(76, 25),
	PIXEL(21, 26),
	PIXEL(22, 26),
	PIXEL(25, 26),
	PIXEL(26, 26),
	PIXEL(41, 26),
	PIXEL(74, 26),
	PIXEL(77, 26),
	PIXEL(22, 27),
	PIXEL(23, 27),
	PIXEL(24, 27),
	PIXEL(25, 27),
	PIXEL(41, 27),
	PIXEL(74, 27),
	PIXEL(78, 27)
};


#define	BLUE_PIXELS	73

unsigned short blue_pixel[BLUE_PIXELS] = {
	PIXEL(51, 19),
	PIXEL(52, 19),
	PIXEL(53, 19),
	PIXEL(54, 19),
	PIXEL(55, 19),
	PIXEL(50, 20),
	PIXEL(51, 20),
	PIXEL(56, 20),
	PIXEL(34, 21),
	PIXEL(35, 21),
	PIXEL(36, 21),
	PIXEL(37, 21),
	PIXEL(50, 21),
	PIXEL(83, 21),
	PIXEL(84, 21),
	PIXEL(85, 21),
	PIXEL(86, 21),
	PIXEL(33, 22),
	PIXEL(34, 22),
	PIXEL(37, 22),
	PIXEL(38, 22),
	PIXEL(50, 22),
	PIXEL(51, 22),
	PIXEL(82, 22),
	PIXEL(83, 22),
	PIXEL(86, 22),
	PIXEL(87, 22),
	PIXEL(33, 23),
	PIXEL(38, 23),
	PIXEL(51, 23),
	PIXEL(52, 23),
	PIXEL(53, 23),
	PIXEL(54, 23),
	PIXEL(55, 23),
	PIXEL(82, 23),
	PIXEL(87, 23),
	PIXEL(33, 24),
	PIXEL(38, 24),
	PIXEL(55, 24),
	PIXEL(56, 24),
	PIXEL(82, 24),
	PIXEL(83, 24),
	PIXEL(84, 24),
	PIXEL(85, 24),
	PIXEL(86, 24),
	PIXEL(87, 24),
	PIXEL(33, 25),
	PIXEL(38, 25),
	PIXEL(56, 25),
	PIXEL(82, 25),
	PIXEL(33, 26),
	PIXEL(34, 26),
	PIXEL(37, 26),
	PIXEL(38, 26),
	PIXEL(50, 26),
	PIXEL(55, 26),
	PIXEL(56, 26),
	PIXEL(82, 26),
	PIXEL(83, 26),
	PIXEL(87, 26),
	PIXEL(34, 27),
	PIXEL(35, 27),
	PIXEL(36, 27),
	PIXEL(37, 27),
	PIXEL(51, 27),
	PIXEL(52, 27),
	PIXEL(53, 27),
	PIXEL(54, 27),
	PIXEL(55, 27),
	PIXEL(83, 27),
	PIXEL(84, 27),
	PIXEL(85, 27),
	PIXEL(86, 27)
};


#define	GREY_PIXELS	220

unsigned short grey_pixel[GREY_PIXELS] = {
	PIXEL(62, 42),
	PIXEL(21, 43),
	PIXEL(22, 43),
	PIXEL(23, 43),
	PIXEL(24, 43),
	PIXEL(51, 43),
	PIXEL(52, 43),
	PIXEL(53, 43),
	PIXEL(62, 43),
	PIXEL(76, 43),
	PIXEL(21, 44),
	PIXEL(25, 44),
	PIXEL(50, 44),
	PIXEL(54, 44),
	PIXEL(62, 44),
	PIXEL(76, 44),
	PIXEL(21, 45),
	PIXEL(25, 45),
	PIXEL(27, 45),
	PIXEL(28, 45),
	PIXEL(29, 45),
	PIXEL(32, 45),
	PIXEL(33, 45),
	PIXEL(34, 45),
	PIXEL(37, 45),
	PIXEL(38, 45),
	PIXEL(39, 45),
	PIXEL(40, 45),
	PIXEL(42, 45),
	PIXEL(43, 45),
	PIXEL(44, 45),
	PIXEL(45, 45),
	PIXEL(50, 45),
	PIXEL(57, 45),
	PIXEL(58, 45),
	PIXEL(59, 45),
	PIXEL(62, 45),
	PIXEL(66, 45),
	PIXEL(67, 45),
	PIXEL(68, 45),
	PIXEL(72, 45),
	PIXEL(73, 45),
	PIXEL(74, 45),
	PIXEL(75, 45),
	PIXEL(76, 45),
	PIXEL(77, 45),
	PIXEL(78, 45),
	PIXEL(21, 46),
	PIXEL(22, 46),
	PIXEL(23, 46),
	PIXEL(24, 46),
	PIXEL(27, 46),
	PIXEL(31, 46),
	PIXEL(35, 46),
	PIXEL(37, 46),
	PIXEL(42, 46),
	PIXEL(51, 46),
	PIXEL(52, 46),
	PIXEL(53, 46),
	PIXEL(56, 46),
	PIXEL(60, 46),
	PIXEL(62, 46),
	PIXEL(65, 46),
	PIXEL(69, 46),
	PIXEL(71, 46),
	PIXEL(76, 46),
	PIXEL(21, 47),
	PIXEL(27, 47),
	PIXEL(31, 47),
	PIXEL(32, 47),
	PIXEL(33, 47),
	PIXEL(34, 47),
	PIXEL(35, 47),
	PIXEL(38, 47),
	PIXEL(39, 47),
	PIXEL(40, 47),
	PIXEL(43, 47),
	PIXEL(44, 47),
	PIXEL(45, 47),
	PIXEL(54, 47),
	PIXEL(56, 47),
	PIXEL(57, 47),
	PIXEL(58, 47),
	PIXEL(59, 47),
	PIXEL(60, 47),
	PIXEL(62, 47),
	PIXEL(65, 47),
	PIXEL(66, 47),
	PIXEL(67, 47),
	PIXEL(68, 47),
	PIXEL(69, 47),
	PIXEL(71, 47),
	PIXEL(76, 47),
	PIXEL(21, 48),
	PIXEL(27, 48),
	PIXEL(31, 48),
	PIXEL(40, 48),
	PIXEL(45, 48),
	PIXEL(50, 48),
	PIXEL(54, 48),
	PIXEL(56, 48),
	PIXEL(62, 48),
	PIXEL(65, 48),
	PIXEL(71, 48),
	PIXEL(76, 48),
	PIXEL(21, 49),
	PIXEL(27, 49),
	PIXEL(32, 49),
	PIXEL(33, 49),
	PIXEL(34, 49),
	PIXEL(35, 49),
	PIXEL(37, 49),
	PIXEL(38, 49),
	PIXEL(39, 49),
	PIXEL(40, 49),
	PIXEL(42, 49),
	PIXEL(43, 49),
	PIXEL(44, 49),
	PIXEL(45, 49),
	PIXEL(51, 49),
	PIXEL(52, 49),
	PIXEL(53, 49),
	PIXEL(57, 49),
	PIXEL(58, 49),
	PIXEL(59, 49),
	PIXEL(60, 49),
	PIXEL(62, 49),
	PIXEL(66, 49),
	PIXEL(67, 49),
	PIXEL(68, 49),
	PIXEL(69, 49),
	PIXEL(72, 49),
	PIXEL(73, 49),
	PIXEL(74, 49),
	PIXEL(76, 49),
	PIXEL(77, 49),
	PIXEL(78, 49),
	PIXEL(33, 56),
	PIXEL(51, 56),
	PIXEL(65, 56),
	PIXEL(33, 57),
	PIXEL(51, 57),
	PIXEL(65, 57),
	PIXEL(32, 58),
	PIXEL(33, 58),
	PIXEL(34, 58),
	PIXEL(35, 58),
	PIXEL(38, 58),
	PIXEL(39, 58),
	PIXEL(40, 58),
	PIXEL(46, 58),
	PIXEL(47, 58),
	PIXEL(48, 58),
	PIXEL(49, 58),
	PIXEL(50, 58),
	PIXEL(51, 58),
	PIXEL(52, 58),
	PIXEL(53, 58),
	PIXEL(56, 58),
	PIXEL(57, 58),
	PIXEL(58, 58),
	PIXEL(61, 58),
	PIXEL(62, 58),
	PIXEL(63, 58),
	PIXEL(64, 58),
	PIXEL(65, 58),
	PIXEL(66, 58),
	PIXEL(67, 58),
	PIXEL(33, 59),
	PIXEL(37, 59),
	PIXEL(41, 59),
	PIXEL(46, 59),
	PIXEL(51, 59),
	PIXEL(59, 59),
	PIXEL(61, 59),
	PIXEL(65, 59),
	PIXEL(33, 60),
	PIXEL(37, 60),
	PIXEL(41, 60),
	PIXEL(47, 60),
	PIXEL(48, 60),
	PIXEL(49, 60),
	PIXEL(51, 60),
	PIXEL(56, 60),
	PIXEL(57, 60),
	PIXEL(58, 60),
	PIXEL(59, 60),
	PIXEL(61, 60),
	PIXEL(65, 60),
	PIXEL(33, 61),
	PIXEL(37, 61),
	PIXEL(41, 61),
	PIXEL(49, 61),
	PIXEL(51, 61),
	PIXEL(55, 61),
	PIXEL(59, 61),
	PIXEL(61, 61),
	PIXEL(65, 61),
	PIXEL(33, 62),
	PIXEL(34, 62),
	PIXEL(35, 62),
	PIXEL(38, 62),
	PIXEL(39, 62),
	PIXEL(40, 62),
	PIXEL(46, 62),
	PIXEL(47, 62),
	PIXEL(48, 62),
	PIXEL(49, 62),
	PIXEL(51, 62),
	PIXEL(52, 62),
	PIXEL(53, 62),
	PIXEL(55, 62),
	PIXEL(56, 62),
	PIXEL(57, 62),
	PIXEL(58, 62),
	PIXEL(59, 62),
	PIXEL(61, 62),
	PIXEL(65, 62),
	PIXEL(66, 62),
	PIXEL(67, 62)
};

#endif /* BACKGROUND_H */
```

## src/controller.c
```c
/*
 * SPDX-License-Identifier: Apache-2.0
 */

#include <zephyr/kernel.h>
#include <zephyr/device.h>
#include <zephyr/drivers/gpio.h>
#include <zephyr/drivers/uart.h>
#include <zephyr/sys/printk.h>
#include <zephyr/sys/__assert.h>
#include <string.h>
#include "controller.h"
#include "threads.h"

K_FIFO_DEFINE(cursor_fifo);

static struct gpio_callback button_cb_data[5];

void button_pressed(const struct device *gpio, struct gpio_callback *cb,
		    uint32_t pins)
{
	const struct gpio_dt_spec plyr1_arrow_right = PLYR1_ARROW_RIGHT_NODE;
	const struct gpio_dt_spec plyr1_arrow_up = PLYR1_ARROW_UP_NODE;
	const struct gpio_dt_spec plyr1_arrow_left = PLYR1_ARROW_LEFT_NODE;
	const struct gpio_dt_spec plyr1_arrow_down = PLYR1_ARROW_DOWN_NODE;
	const struct gpio_dt_spec plyr1_select = PLYR1_SELECT_NODE;
	struct cursor_data cursor_tx;
	int ret;

	if (pins == BIT(plyr1_arrow_up.pin)) {
		cursor_tx.command = PLYR1_ARROW_UP;
		printk("Cursor up pressed\n");
	}
	if (pins == BIT(plyr1_arrow_right.pin)) {
		cursor_tx.command = PLYR1_ARROW_RIGHT;
		printk("Cursor right pressed\n");
	}
	if (pins == BIT(plyr1_arrow_down.pin)) {
		cursor_tx.command = PLYR1_ARROW_DOWN;
		printk("Cursor down pressed\n");
	}
	if (pins == BIT(plyr1_arrow_left.pin)) {
		cursor_tx.command = PLYR1_ARROW_LEFT;
		printk("Cursor left pressed\n");
	}
	if (pins == BIT(plyr1_select.pin)) {
		cursor_tx.command = PLYR1_SELECT;
		printk("Cursor select pressed\n");
	}

	ret = k_fifo_alloc_put(&cursor_fifo, &cursor_tx);
	if (ret == -ENOMEM)
		printk("Unable to add cursor command to FIFO: -ENOMEM\n");
}

int initialize_button(const struct gpio_dt_spec *button)
{
	int ret;
	int pin;

	if (button == NULL) {
		printk("Error: didn't find button\n");
		return -1;
	}
	pin = button->pin;

	ret = gpio_pin_configure_dt(button, button->dt_flags);
	if (ret != 0) {
		printk("Error %d: failed to configure pin %s\n",
		       ret, button->port->name);
		return ret;
	}

	ret = gpio_pin_interrupt_configure_dt(button, GPIO_INT_EDGE_TO_ACTIVE);
	if (ret != 0) {
		printk("Error %d: failed to configure interrupt on pin %s\n",
			ret, button->port->name);
		return ret;
	}

	gpio_init_callback(&button_cb_data[pin], button_pressed, BIT(pin));
	ret = gpio_add_callback(button->port, &button_cb_data[pin]);
	if (ret != 0) {
		printk("Error %d: failed to add callback on pin %s\n",
			ret, button->port->name);
		return ret;
	}
	printk("Set up button at %s pin %d\n", button->port->name, pin);

	return 0;
}

void controller(void)
{
	const struct gpio_dt_spec plyr1_arrow_right = PLYR1_ARROW_RIGHT_NODE;
	const struct gpio_dt_spec plyr1_arrow_up = PLYR1_ARROW_UP_NODE;
	const struct gpio_dt_spec plyr1_arrow_left = PLYR1_ARROW_LEFT_NODE;
	const struct gpio_dt_spec plyr1_arrow_down = PLYR1_ARROW_DOWN_NODE;
	const struct gpio_dt_spec plyr1_select = PLYR1_SELECT_NODE;
	int ret;

	ret = initialize_button(&plyr1_arrow_right);
	if (ret < 0)
		return;

	ret = initialize_button(&plyr1_arrow_up);
	if (ret < 0)
		return;

	ret = initialize_button(&plyr1_arrow_left);
	if (ret < 0)
		return;

	ret = initialize_button(&plyr1_arrow_down);
	if (ret < 0)
		return;

	ret = initialize_button(&plyr1_select);
	if (ret < 0)
		return;

	while(1) {
		k_sleep(K_SECONDS(1));
	}
}

K_THREAD_DEFINE(controller_tid, CONTROLLER_STACKSIZE, controller, NULL, NULL,
		NULL, CONTROLLER_PRIORITY, 0, 0);
```

## src/controller.h
```c
#ifndef CONTROLLER_H
#define CONTROLLER_H

struct cursor_data {
	void *fifo_reserved;
	unsigned int command;
};

#define PLYR1_ARROW_RIGHT	0x1 <<  0
#define PLYR1_ARROW_UP		0x1 <<  1
#define PLYR1_ARROW_LEFT	0x1 <<  2
#define PLYR1_ARROW_DOWN	0x1 <<  3
#define PLYR1_BACK_LEFT		0x1 <<  4
#define PLYR1_BACK_RIGHT	0x1 <<  5
#define PLYR1_A			0x1 <<  6
#define PLYR1_B			0x1 <<  7
#define PLYR1_X			0x1 <<  8
#define PLYR1_Y			0x1 <<  9
#define PLYR1_SELECT		0x1 << 10
#define PLYR1_START		0x1 << 11

#define PLYR1_ARROW_RIGHT_NODE	GPIO_DT_SPEC_GET(DT_PATH(keys, player1_arrow_right), gpios)
#define PLYR1_ARROW_UP_NODE	GPIO_DT_SPEC_GET(DT_PATH(keys, player1_arrow_up), gpios)
#define PLYR1_ARROW_LEFT_NODE	GPIO_DT_SPEC_GET(DT_PATH(keys, player1_arrow_left), gpios)
#define PLYR1_ARROW_DOWN_NODE	GPIO_DT_SPEC_GET(DT_PATH(keys, player1_arrow_down), gpios)
#define PLYR1_SELECT_NODE	GPIO_DT_SPEC_GET(DT_PATH(keys, player1_select), gpios)

#endif /* CONTROLLER_H */
```

## src/heartbeat.c
```c
/*
 * SPDX-License-Identifier: Apache-2.0
 */

#include <zephyr.h>
#include <device.h>
#include <drivers/gpio.h>
#include <sys/__assert.h>
#include "heartbeat.h"
#include "threads.h"

void heartbeat(void)
{
	const struct device *led_dev;

	led_dev = device_get_binding(LED_HEARTBEAT_CTRL);
	__ASSERT_NO_MSG(led_dev != NULL);

	gpio_pin_configure(led_dev, LED_HEARTBEAT_PIN,
		LED_HEARTBEAT_FLAGS | GPIO_OUTPUT);

	while (1) {
		gpio_pin_set(led_dev, LED_HEARTBEAT_PIN, 1);
		k_sleep(K_MSEC(150));
		gpio_pin_set(led_dev, LED_HEARTBEAT_PIN, 0);
		k_sleep(K_MSEC(50));
		gpio_pin_set(led_dev, LED_HEARTBEAT_PIN, 1);
		k_sleep(K_MSEC(150));
		gpio_pin_set(led_dev, LED_HEARTBEAT_PIN, 0);
		k_sleep(K_SECONDS(1));
	}
}

K_THREAD_DEFINE(heartbeat_tid, HEARTBEAT_STACKSIZE, heartbeat, NULL, NULL, NULL,
		HEARTBEAT_PRIORITY, 0, 0);
```

## src/heartbeat.h
```c
#ifndef HEARTBEAT_H
#define HEARTBEAT_H

#define LED_HEARTBEAT		DT_PATH(leds, heartbeat)
#define LED_HEARTBEAT_CTRL	DT_PROP(DT_PHANDLE_BY_IDX(LED_HEARTBEAT, gpios, 0), label)
#define LED_HEARTBEAT_PIN	DT_PHA_BY_IDX(LED_HEARTBEAT, gpios, 0, pin)
#define LED_HEARTBEAT_FLAGS	DT_PHA_BY_IDX(LED_HEARTBEAT, gpios, 0, flags)

#endif /* HEARTBEAT_H */
```

## src/threads.h
```c
#ifndef THREADS_H
#define THREADS_H

/* size of stack area used by each thread */
#define HEARTBEAT_STACKSIZE 2048
#define FRAMESYNC_STACKSIZE 4096
#define PIXELMOVER_STACKSIZE 2048
#define CONTROLLER_STACKSIZE 2048

/* scheduling priority used by each thread */
#define HEARTBEAT_PRIORITY 7
#define FRAMESYNC_PRIORITY 4
#define PIXELMOVER_PRIORITY 5
#define CONTROLLER_PRIORITY 6

#endif /* THREADS_H */
```
