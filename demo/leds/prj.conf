## CMakeLists.txt
```
cmake_minimum_required(VERSION 3.13.1)

find_package(Zephyr)
project(demo_leds)

target_sources(app PRIVATE src/main.c ../../common/heartbeat.c ../../common/sw0.c)
```

## sample.yaml
```
sample:
  description: Demo application for LEDs
  name: LED demo
common:
    tags: demo
    depends_on: gpio
```

## prj.conf
```kconfig
CONFIG_BOOT_BANNER=y
CONFIG_PRINTK=y
CONFIG_CONSOLE=y
CONFIG_UART_CONSOLE=y
CONFIG_SHELL=y
CONFIG_LOG=y
CONFIG_GPIO_SHELL=y
CONFIG_LED=y
CONFIG_LED_SHELL=y
CONFIG_PWM_SHELL=y
CONFIG_I2C_SHELL=y
CONFIG_OUTPUT_DISASSEMBLY=y
CONFIG_OUTPUT_DISASSEMBLE_ALL=y
```

## src/main.c
```c
/*
 * SPDX-License-Identifier: Apache-2.0
 */

#include <zephyr/kernel.h>
#include <zephyr/device.h>
#include <zephyr/drivers/gpio.h>
#include <zephyr/drivers/uart.h>
#include <zephyr/sys/printk.h>
#include <zephyr/sys/__assert.h>
#include <string.h>

#include "../../../common/heartbeat.h"
#include "../../../common/sw0.h"

K_THREAD_DEFINE(heartbeat_tid, HEARTBEAT_STACKSIZE, heartbeat, NULL, NULL, NULL,
		HEARTBEAT_PRIORITY, 0, 0);

K_THREAD_DEFINE(software0_key_tid, SOFTWARE0_KEY_STACKSIZE, software0_key,
		NULL, NULL, NULL, SOFTWARE0_KEY_PRIORITY, 0, 0);
```
