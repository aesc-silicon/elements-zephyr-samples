## CMakeLists.txt
```
cmake_minimum_required(VERSION 3.13.1)

find_package(Zephyr)
project(reset)

target_sources(app PRIVATE src/main.c)
```

## prj.conf
```kconfig
CONFIG_BOOT_BANNER=n
CONFIG_PRINTK=y
CONFIG_CONSOLE=y
CONFIG_UART_CONSOLE=y
CONFIG_LOG=y
CONFIG_OUTPUT_DISASSEMBLY=y
CONFIG_OUTPUT_DISASSEMBLE_ALL=y
```

## src/main.c
```c
/*
 * SPDX-License-Identifier: Apache-2.0
 */

#include <zephyr/kernel.h>
#include <zephyr/device.h>
#include <zephyr/drivers/gpio.h>
#include <zephyr/drivers/uart.h>
#include <zephyr/sys/reboot.h>
#include <zephyr/sys/printk.h>
#include <zephyr/sys/__assert.h>
#include <string.h>

/* size of stack area used by each thread */
#define STACKSIZE 2048

/* scheduling priority used by each thread */
#define PRIORITY 7

void startup_reset(void)
{
	printk("Triggering warm reboot.\n");
	k_sleep(K_MSEC(5));
	sys_reboot(SYS_REBOOT_WARM);

	k_sleep(K_MSEC(1));
	printk("Reset failed!\n");

	while (1) {
		k_sleep(K_SECONDS(1));
	}
}

K_THREAD_DEFINE(startup_reset_tid, STACKSIZE, startup_reset, NULL, NULL, NULL,
		PRIORITY, 0, 0);
```
